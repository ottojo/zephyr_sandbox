## oot_module/boards/arm/otterpill/Kconfig.board
```kconfig
config BOARD_OTTERPILL
    bool "Otterpill Board"
    depends on SOC_STM32F072X8
```

## oot_module/boards/arm/otterpill/otterpill_defconfig
```kconfig
# Zephyr Kernel Configuration
CONFIG_SOC_SERIES_STM32F0X=y

# Platform Configuration
CONFIG_SOC_STM32F072X8=y

# Serial Drivers
CONFIG_SERIAL=y
CONFIG_UART_INTERRUPT_DRIVEN=y
# Enable console
CONFIG_CONSOLE=y
CONFIG_UART_CONSOLE=y

# GPIO Controller
CONFIG_GPIO=y

# Enable Clocks
CONFIG_CLOCK_CONTROL=y

# Enable pin control
CONFIG_PINCTRL=y

CONFIG_USB_DEVICE_STACK=y
CONFIG_USB_DEVICE_PRODUCT="OtterPill Dev Board"
```

## oot_module/dts/bindings/usb-c/fcs,fusb302b-vbus.yml
```yaml
description: USB-C VBUS measurement using FUSB302B

compatible: "fcs,fusb302b-vbus"

include: base.yaml

properties:
  fusb302b:
    type: phandle
    required: true
```

## oot_module/dts/bindings/usb-c/fcs,fusb302b.yml
```yaml
description: FUSB302B Programmable USB Type-C Controller with PD

compatible: "fcs,fusb302b"

include: i2c-device.yaml
```
