## CMakeLists.txt
```
cmake_minimum_required(VERSION 3.20.0)

set(EXTRA_ZEPHYR_MODULES ${CMAKE_CURRENT_SOURCE_DIR}/../stm32_comp)
find_package(Zephyr REQUIRED HINTS $ENV{ZEPHYR_BASE})
project(comparator_app)

target_sources(app PRIVATE src/main.c)
```

## prj.conf
```kconfig
CONFIG_LOG=y
CONFIG_COMPARATOR=y
CONFIG_COMPARATOR_LOG_LEVEL_DBG=y
CONFIG_COMPARATOR_STM32=y
```

## boards/otterpill.overlay
```dts
#include <zephyr/dt-bindings/comparator/stm32.h>

/ {
    soc {
        comp1: comp@4001001c {
            compatible = "st,stm32f0-comparator";
            status = "okay";
            reg = <0x4001001c 2>;

            pinctrl-0 = <&comp1_inp_pa1 &comp1_out_pa6>;
            pinctrl-names = "default";

            zephyr,input-positive = <COMP_NONINVERTINGINPUT_IO1>;
            zephyr,input-negative = <COMP_INVERTINGINPUT_1_2VREFINT>;
            /delete-property/ zephyr,invert-output;
            zephyr,output = <COMP_OUTPUT_NONE>;

        };

        comp2: comp@4001001e {
            compatible = "st,stm32f0-comparator";
            status = "okay";
            reg = <0x4001001e 2>;

            pinctrl-0 = <&comp2_inp_pa3 &comp2_out_pa2>;
            pinctrl-names = "default";

            zephyr,input-positive = <COMP_NONINVERTINGINPUT_IO1>;
            zephyr,input-negative = <COMP_INVERTINGINPUT_1_2VREFINT>;
            //zephyr,invert-output;
            zephyr,output = <COMP_OUTPUT_NONE>;
        };
    };
};
```

## src/main.c
```c
#include "autoconf.h"
#include <stdbool.h>
#include <zephyr/kernel.h>

#ifndef CONFIG_COMPARATOR_STM32
#error stm32 comparator not found!
#endif

int main() {
  while (true) {
    k_msleep(100);
  }
}
```
